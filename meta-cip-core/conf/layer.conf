## meta-cip-core/conf/layer.conf
```bitbake
# We have a conf and classes directory, add to BBPATH
BBPATH =. "${LAYERDIR}:"

# We have recipes-* directories, add to BBFILES
BBFILES += "${LAYERDIR}/recipes-*/*/*.bb \
            ${LAYERDIR}/recipes-*/*/*.bbappend"

BBFILE_COLLECTIONS += "cip-core"
BBFILE_PATTERN_cip-core = "^${LAYERDIR}/"
BBFILE_PRIORITY_cip-core = "11"

# This should only be incremented on significant changes that will
# cause compatibility issues with other layers
LAYERVERSION_cip-core = "1"

LAYERDEPENDS_cip-core = "debian"

LAYERSERIES_COMPAT_cip-core = "warrior"
```

## meta-cip-security/conf/layer.conf
```bitbake
# We have a conf and classes directory, add to BBPATH
BBPATH =. "${LAYERDIR}:"

# We have recipes-* directories, add to BBFILES
BBFILES += "${LAYERDIR}/recipes-*/*/*.bb \
            ${LAYERDIR}/recipes-*/*/*.bbappend"

BBFILE_COLLECTIONS += "cip-security"
BBFILE_PATTERN_cip-security = "^${LAYERDIR}/"
BBFILE_PRIORITY_cip-security = "11"

# This should only be incremented on significant changes that will
# cause compatibility issues with other layers
LAYERVERSION_cip-security = "1"

LAYERDEPENDS_cip-security = "debian"

LAYERSERIES_COMPAT_cip-security = "warrior"
```

## meta-de0-nano-soc/conf/layer.conf
```bitbake
# We have a conf and classes directory, add to BBPATH
BBPATH =. "${LAYERDIR}:"

# We have recipes-* directories, add to BBFILES
BBFILES += "${LAYERDIR}/recipes-*/*/*.bb \
            ${LAYERDIR}/recipes-*/*/*.bbappend"

BBFILE_COLLECTIONS += "de0-nano-soc"
BBFILE_PATTERN_de0-nano-soc = "^${LAYERDIR}/"
BBFILE_PRIORITY_de0-nano-soc = "11"

# This should only be incremented on significant changes that will
# cause compatibility issues with other layers
LAYERVERSION_de0-nano-soc = "1"

LAYERDEPENDS_de0-nano-soc = "debian"

LAYERSERIES_COMPAT_de0-nano-soc = "warrior"
```

## meta-de0-nano-soc/conf/machine/de0-nano-soc.conf
```bitbake
#@TYPE: Machine
#@NAME: de0-nano-soc
#@DESCRIPTION: Terasic DE0-Nano-SoC Kit

require conf/machine/include/tune-cortexa9.inc

IMAGE_FSTYPES_append = " tar.bz2 ext4"

KERNEL_IMAGETYPE = "zImage"
KERNEL_DEVICETREE = "\
    socfpga_cyclone5_de0_nano_soc.dtb \
"

SERIAL_CONSOLE = "115200 ttyS0"

# TODO: U-Boot settings for de0-nano-soc
```

## meta-hihope-rzg2m/conf/layer.conf
```bitbake
# We have a conf and classes directory, add to BBPATH
BBPATH =. "${LAYERDIR}:"

# We have recipes-* directories, add to BBFILES
BBFILES += "${LAYERDIR}/recipes-*/*/*.bb \
            ${LAYERDIR}/recipes-*/*/*.bbappend"

BBFILE_COLLECTIONS += "hihope-rzg2m"
BBFILE_PATTERN_hihope-rzg2m = "^${LAYERDIR}/"
BBFILE_PRIORITY_hihope-rzg2m = "11"

# This should only be incremented on significant changes that will
# cause compatibility issues with other layers
LAYERVERSION_hihope-rzg2m = "1"

LAYERDEPENDS_hihope-rzg2m = "debian"

LAYERSERIES_COMPAT_hihope-rzg2m = "warrior"
```

## meta-hihope-rzg2m/conf/machine/hihope-rzg2m.conf
```bitbake
#@TYPE: Machine
#@NAME: hihope-rzg2m
#@DESCRIPTION: Hoperun Technology HiHope RZ/G2M platform

DEFAULTTUNE ?= "cortexa57-cortexa53"
require conf/machine/include/tune-cortexa57-cortexa53.inc

KERNEL_IMAGETYPE = "Image"
IMAGE_FSTYPES_append = " tar.bz2 ext4"

KERNEL_DEVICETREE = " \
    renesas/r8a774a1-hihope-rzg2m.dtb \
    renesas/r8a774a1-hihope-rzg2m-ex.dtb \
"

SERIAL_CONSOLE = "115200 ttySC0"

# TODO: U-Boot settings for hihope-rzg2m
```

## meta-hihope-rzg2n/conf/layer.conf
```bitbake
# We have a conf and classes directory, add to BBPATH
BBPATH =. "${LAYERDIR}:"

# We have recipes-* directories, add to BBFILES
BBFILES += "${LAYERDIR}/recipes-*/*/*.bb \
            ${LAYERDIR}/recipes-*/*/*.bbappend"

BBFILE_COLLECTIONS += "hihope-rzg2n"
BBFILE_PATTERN_hihope-rzg2n = "^${LAYERDIR}/"
BBFILE_PRIORITY_hihope-rzg2n = "11"

# This should only be incremented on significant changes that will
# cause compatibility issues with other layers
LAYERVERSION_hihope-rzg2n = "1"

LAYERDEPENDS_hihope-rzg2n = "debian"

LAYERSERIES_COMPAT_hihope-rzg2n = "warrior"
```

## meta-hihope-rzg2n/conf/machine/hihope-rzg2n.conf
```bitbake
#@TYPE: Machine
#@NAME: hihope-rzg2n
#@DESCRIPTION: Hoperun Technology HiHope RZ/G2N platform

DEFAULTTUNE ?= "cortexa57"
require conf/machine/include/tune-cortexa57.inc

KERNEL_IMAGETYPE = "Image"
IMAGE_FSTYPES_append = " tar.bz2 ext4"

KERNEL_DEVICETREE = "renesas/r8a774b1-hihope-rzg2n-ex.dtb"

SERIAL_CONSOLE = "115200 ttySC0"

# TODO: U-Boot settings for hihope-rzg2n
```

## meta-iwg20m/conf/layer.conf
```bitbake
# We have a conf and classes directory, add to BBPATH
BBPATH =. "${LAYERDIR}:"

# We have recipes-* directories, add to BBFILES
BBFILES += "${LAYERDIR}/recipes-*/*/*.bb \
            ${LAYERDIR}/recipes-*/*/*.bbappend"

BBFILE_COLLECTIONS += "iwg20m"
BBFILE_PATTERN_iwg20m = "^${LAYERDIR}/"
BBFILE_PRIORITY_iwg20m = "11"

# This should only be incremented on significant changes that will
# cause compatibility issues with other layers
LAYERVERSION_iwg20m = "1"

LAYERDEPENDS_iwg20m = "debian"

LAYERSERIES_COMPAT_iwg20m = "warrior"
```

## meta-iwg20m/conf/machine/iwg20m.conf
```bitbake
#@TYPE: Machine
#@NAME: iwg20m
#@DESCRIPTION: iWave RZ/G1M Qseven Development Kit

DEFAULTTUNE ?= "cortexa15hf-neon-vfpv4"
require conf/machine/include/tune-cortexa15.inc

IMAGE_FSTYPES_append = " tar.bz2 ext4"

KERNEL_IMAGETYPE = "uImage"
KERNEL_DEVICETREE = "\
    r8a7743-iwg20d-q7.dtb \
    r8a7743-iwg20d-q7-dbcm-ca.dtb \
"

SERIAL_CONSOLE = "115200 ttySC0"

KERNEL_EXTRA_ARGS += "LOADADDR=${UBOOT_ENTRYPOINT}"
UBOOT_ENTRYPOINT = "0x40008000"
UBOOT_LOADADDRESS = "0x40008000"

# TODO: U-Boot settings for iwg20m
```

## meta-r8a774c0-ek874/conf/layer.conf
```bitbake
# We have a conf and classes directory, add to BBPATH
BBPATH =. "${LAYERDIR}:"

# We have recipes-* directories, add to BBFILES
BBFILES += "${LAYERDIR}/recipes-*/*/*.bb \
            ${LAYERDIR}/recipes-*/*/*.bbappend"

BBFILE_COLLECTIONS += "r8a774c0-ek874"
BBFILE_PATTERN_r8a774c0-ek874 = "^${LAYERDIR}/"
BBFILE_PRIORITY_r8a774c0-ek874 = "11"

# This should only be incremented on significant changes that will
# cause compatibility issues with other layers
LAYERVERSION_r8a774c0-ek874 = "1"

LAYERDEPENDS_r8a774c0-ek874 = "debian"

LAYERSERIES_COMPAT_r8a774c0-ek874 = "warrior"
```

## meta-r8a774c0-ek874/conf/machine/r8a774c0-ek874.conf
```bitbake
#@TYPE: Machine
#@NAME: r8a774c0-ek874
#@DESCRIPTION: Silicon Linux RZ/G2E evaluation kit (EK874)

DEFAULTTUNE ?= "cortexa53"
require conf/machine/include/tune-cortexa53.inc

KERNEL_IMAGETYPE = "Image"
IMAGE_FSTYPES_append = " tar.bz2 ext4"

KERNEL_DEVICETREE = "renesas/r8a774c0-ek874.dtb"

SERIAL_CONSOLE = "115200 ttySC0"

# TODO: U-Boot settings for r8a774c0-ek874
```

## meta-simatic-ipc227e/conf/layer.conf
```bitbake
# We have a conf and classes directory, add to BBPATH
BBPATH =. "${LAYERDIR}:"

# We have recipes-* directories, add to BBFILES
BBFILES += "${LAYERDIR}/recipes-*/*/*.bb \
            ${LAYERDIR}/recipes-*/*/*.bbappend"

BBFILE_COLLECTIONS += "simatic-ipc227e"
BBFILE_PATTERN_simatic-ipc227e = "^${LAYERDIR}/"
BBFILE_PRIORITY_simatic-ipc227e = "11"

# This should only be incremented on significant changes that will
# cause compatibility issues with other layers
LAYERVERSION_simatic-ipc227e = "1"

LAYERDEPENDS_simatic-ipc227e = "debian"

LAYERSERIES_COMPAT_simatic-ipc227e = "warrior"
```

## meta-simatic-ipc227e/conf/machine/simatic-ipc227e.conf
```bitbake
#@TYPE: Machine
#@NAME: simatic-ipc227e
#@DESCRIPTION: Siemens SIMATIC IPC227E

DEFAULTTUNE ?= "core2-64"
require conf/machine/include/tune-core2.inc

KERNEL_IMAGETYPE = "bzImage"
IMAGE_FSTYPES_append = " tar.bz2 ext4"

SERIAL_CONSOLE = "115200 ttyS0"
```

## meta-zynqmp-zcu102/conf/layer.conf
```bitbake
# We have a conf and classes directory, add to BBPATH
BBPATH .= ":${LAYERDIR}"

# We have a packages directory, add to BBFILES
BBFILES += "${LAYERDIR}/recipes-*/*/*.bb"
BBFILES += "${LAYERDIR}/recipes-*/*/*.bbappend"

BBFILE_COLLECTIONS += "zynqmp-zcu102"
BBFILE_PATTERN_zynqmp-zcu102 = "^${LAYERDIR}/"
BBFILE_PRIORITY_zynqmp-zcu102 = "11"

LAYERDEPENDS_zynqmp-zcu102 = "debian"

LAYERSERIES_COMPAT_zynqmp-zcu102 = "warrior"

BB_DANGLINGAPPENDS_WARNONLY ?= "1"
```

## meta-zynqmp-zcu102/conf/machine/zynqmp-zcu102.conf
```bitbake
#@TYPE: Machine
#@NAME: zcu102-zynqmp
#@DESCRIPTION: Machine support for ZCU102 Evaluation Board.

SOC_VARIANT ?= "eg"

require conf/machine/include/tune-zynqmp.inc
require conf/machine/include/machine-xilinx-overrides.inc
require conf/machine/include/machine-xilinx-default.inc
#require conf/machine/include/machine-xilinx-qemu.inc

MACHINE_FEATURES = "rtc ext2 ext3 vfat usbhost"

IMAGE_FSTYPES_append = " tar.bz2 ext4"

SERIAL_CONSOLE = "115200 ttyPS0"

KERNEL_DEVICETREE = "xilinx/zynqmp-zcu102-rev1.0.dtb"

PREFERRED_PROVIDER_virtual/kernel ?= "linux-xlnx"
```
